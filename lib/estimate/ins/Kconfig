## lib/estimate/ins/Kconfig
```kconfig
# Copyright (c) 2023, CogniPilot Foundation
# SPDX-License-Identifier: Apache-2.0

menuconfig CEREBRI_ESTIMATE_INS
  bool "ins"
  help
    This option enables the ins estimator

if CEREBRI_ESTIMATE_INS

module = CEREBRI_ESTIMATE_INS
module-str = estimate_ins
source "subsys/logging/Kconfig.template.log_config"

endif # CEREBRI_ESTIMATE_INS
```

## lib/synapse/zenoh/Kconfig
```kconfig
# Copyright (c) 2023, CogniPilot Foundation
# SPDX-License-Identifier: Apache-2.0

config CEREBRI_SYNAPSE_ZENOH
  bool "Ethernet"
  default y
  depends on ZENOH_PICO
  help
    This option enables the synapse zenoh interface

if CEREBRI_SYNAPSE_ZENOH

module = CEREBRI_SYNAPSE_ZENOH
module-str = synapse_zenoh
source "subsys/logging/Kconfig.template.log_config"

endif # CEREBRI_SYNAPSE_ZENOH
```

## tests/lib/synapse/zros/testcase.yaml
```yaml
common:
  tags: zros
  integration_platforms:
    - native_sim
tests:
  lib.synapse.zros: {}
```
