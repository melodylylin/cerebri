## CMakeLists.txt
```
#-------------------------------------------------------------------------------
# Zephyr Cerebri Application
#
# Copyright (c) 2023 CogniPilot Foundation
# SPDX-License-Identifier: Apache-2.0

cmake_minimum_required(VERSION 3.13.1)

find_package(Zephyr REQUIRED HINTS $ENV{ZEPHYR_BASE})

project(zros_minimal LANGUAGES C)

target_include_directories(app PRIVATE ${CMAKE_CURRENT_SOURCE_DIR})

target_compile_options(app PRIVATE -Wall -Wextra -Wno-unused-parameter -Werror)

target_sources(app PRIVATE
  src/main.c
  src/publisher.c
  src/subscriber.c
  src/topic_list.c
  )
```

## prj.conf
```kconfig
CONFIG_ZTEST=y
CONFIG_LOG=y

CONFIG_CEREBRI_SYNAPSE_ZROS=y
```

## src/main.c
```c
#include <zephyr/kernel.h>
#include <zephyr/logging/log.h>
#include <zephyr/ztest.h>

LOG_MODULE_REGISTER(main, LOG_LEVEL_DBG);

#define MY_STACK_SIZE 1024
#define MY_PRIORITY 5

extern void pub_entry_point(void*, void*, void*);
extern void sub_entry_point(void*, void*, void*);

K_THREAD_STACK_DEFINE(pub_stack_area, MY_STACK_SIZE);
K_THREAD_STACK_DEFINE(sub_stack_area, MY_STACK_SIZE);

ZTEST(zros, test_pub_sub)
{
    struct k_thread pub_thread;
    k_tid_t pub_tid = k_thread_create(
        &pub_thread, pub_stack_area,
        K_THREAD_STACK_SIZEOF(pub_stack_area),
        pub_entry_point,
        NULL, NULL, NULL,
        MY_PRIORITY, 0, K_FOREVER);

    struct k_thread sub_thread;
    k_tid_t sub_tid = k_thread_create(
        &sub_thread, sub_stack_area,
        K_THREAD_STACK_SIZEOF(sub_stack_area),
        sub_entry_point,
        NULL, NULL, NULL,
        MY_PRIORITY, 0, K_FOREVER);

    int rc = 0;
    LOG_INF("starting pub");
    k_thread_start(pub_tid);
    LOG_INF("starting sub");
    k_thread_start(sub_tid);
    LOG_INF("joining pub");
    rc = k_thread_join(pub_tid, K_MSEC(10000));
    zassert_true(rc == 0, "failed to join pub thread");
    LOG_INF("joining sub");
    rc = k_thread_join(sub_tid, K_MSEC(10000));
    zassert_true(rc == 0, "failed to join sub thread");
}

ZTEST_SUITE(zros, NULL, NULL, NULL, NULL, NULL);

// vi: ts=4 sw=4 et
```

## src/publisher.c
```c
#include <stdio.h>
#include <zephyr/kernel.h>

// for this example, we will use a self-contained topic list,
// typically you would use a pre-defined topic in
// #include <synapse_topic_list.h>
#include "topic_list.h"

#include <zros/zros_node.h>
#include <zros/zros_pub.h>

// private headers are necessary when you must
// allocate a zros data structure of the given type
#include <zros/private/zros_node_struct.h>
#include <zros/private/zros_pub_struct.h>

// to enable ZROS logging
#include <zephyr/logging/log.h>

#define MY_STACK_SIZE 2048
#define MY_PRIORITY 5

LOG_MODULE_REGISTER(publisher, LOG_LEVEL_DBG);

static struct zros_node node;
static struct zros_pub pub;

// declare a local msg that is copied to the topic during publish
static my_struct_t my_data = {
    .buf = "hello",
};

// declare the pub entry point thread
void pub_entry_point(void* p0, void* p1, void* p2)
{
    ARG_UNUSED(p0);
    ARG_UNUSED(p1);
    ARG_UNUSED(p2);

    // initialize a node
    zros_node_init(&node, "my_node");
    // initialize a publisher on the node
    int rc = zros_pub_init(&pub, &node, &topic_example, &my_data);
    if (rc < 0) {
        LOG_ERR("pub init failed");
    }

    // loop and publish
    for (int i = 0; i < 10; i++) {
        // wait one second
        k_msleep(100);
        // increment sequence
        snprintf(my_data.buf, sizeof(my_data.buf), "hello world %d", i);
        // publish data tied to publisher to the topic data
        // this is thread safe
        zros_pub_update(&pub);
        LOG_INF("%s", my_data.buf);
    }
};

// vi: ts=4 sw=4 et
```

## src/subscriber.c
```c
#include <zephyr/kernel.h>

// for this example, we will use a self-contained topic list,
// typically you would use a pre-defined topic in
// #include <synapse_topic_list.h>
#include "topic_list.h"
#include <zephyr/ztest.h>

#define MY_STACK_SIZE 2048
#define MY_PRIORITY 5

#include <zros/zros_node.h>
#include <zros/zros_sub.h>

// private headers are necessary when you must
// allocate a zros data structure of the given type
#include <zros/private/zros_node_struct.h>
#include <zros/private/zros_sub_struct.h>

#include <zephyr/logging/log.h>

LOG_MODULE_REGISTER(subscriber, LOG_LEVEL_DBG);

static struct zros_node node;
static struct zros_sub sub;

// declare a local msg that is copied to during sub update
static my_struct_t my_data = {};

void sub_entry_point(void* p0, void* p1, void* p2)
{
    zros_node_init(&node, "sub");
    int rc = 0;
    rc = zros_sub_init(&sub, &node, &topic_example, &my_data, 10);
    zassert_true((rc == 0), "failed initializaing sub");

    struct k_poll_event events[] = {
        *zros_sub_get_event(&sub),
    };

    for (int i = 0; i < 10; i++) {
        // wait for publication signal
        int rc = 0;
        rc = k_poll(events, ARRAY_SIZE(events), K_MSEC(10000));
        zassert_true((rc == 0), "poll timeout");
        if (rc != 0) {
            LOG_WRN("poll timeout while waiting for publication");
        }

        if (zros_sub_update_available(&sub)) {
            zros_sub_update(&sub);
            LOG_INF("%s", my_data.buf);
        }
    }
};

// vi: ts=4 sw=4 et
```

## src/topic_list.c
```c
#include "topic_list.h"

#include <zros/private/zros_topic_struct.h>

#include <zephyr/logging/log.h>

LOG_MODULE_REGISTER(topic_list, LOG_LEVEL_DBG);

// This example will define a new topic in this file. This is not
// the standard procedure, as typcially all topics are declared in
// lib/synapse/topic/include/synapse_topic_list.c. We do it here to
// make the example self-contained ane make the overall API clear.

ZROS_TOPIC_DEFINE(example, my_struct_t);

// This function is called at boot before any applications are run, it declare that the
// new topic exists, by adding it to the broker, this is useful for zros topic list.
// This is called for all topics in one file (see above).
static int set_topic_list()
{
    LOG_INF("adding topic to broker list");
    return zros_broker_add_topic(&topic_example);
}

// This registeres the set_topic_list to be called at boot, and is also done for standard
// Cerebri apps in lib/synapse/topic/src/synapse_topic_list.c
SYS_INIT(set_topic_list, APPLICATION, CONFIG_APPLICATION_INIT_PRIORITY);

// vi: ts=4 sw=4 et
```

## src/topic_list.h
```c
#ifndef ZROS_MINIMAL_TOPIC_LIST_H
#define ZROS_MINIMAL_TOPIC_LIST_H

// This example will declare a new topic in this file. This is not
// the standard procedure, as typcially all topics are declared in
// lib/synapse/topic/include/synapse_topic_list.h. We do it here to
// make the example self-contained ane make the overall API clear.

#include <zros/zros_broker.h>
#include <zros/zros_topic.h>

typedef struct my_struct {
    char buf[30];
} my_struct_t;

ZROS_TOPIC_DECLARE(topic_example, my_struct);

// vi: ts=4 sw=4 et

#endif // ZROS_MINIMAL_TOPIC_LIST_H
```
