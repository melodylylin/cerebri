## CMakeLists.txt
```
#-------------------------------------------------------------------------------
# Zephyr Cerebri Application
#
# Copyright (c) 2023 CogniPilot Foundation
# SPDX-License-Identifier: Apache-2.0

cmake_minimum_required(VERSION 3.13.1)

set(MODULE_EXT_ROOT ${CMAKE_CURRENT_SOURCE_DIR}/../..)

if (${BOARD} STREQUAL "mr_canhubk3")
  message(STATUS "enabling mr_canhubk3_adap shield")
  set(SHIELD mr_canhubk3_adap)
endif()

find_package(Zephyr REQUIRED HINTS $ENV{ZEPHYR_BASE})

project(b3rb LANGUAGES C)

target_compile_options(app PRIVATE -Wall -Wextra -Werror -Wno-unused-parameter -Wno-type-limits)

target_link_libraries(app PRIVATE zenoh-pico)

set(SOURCE_FILES
  src/z_sub.c
  )

target_sources(app PRIVATE ${SOURCE_FILES})

#add_custom_target(install_files ALL
#	DEPENDS ${ZEPHYR_FINAL_EXECUTABLE}
#)

#add_custom_command(
#    TARGET install_files
#    POST_BUILD
#    COMMAND ${CMAKE_COMMAND} --build ${CMAKE_BINARY_DIR} --target install
#    )
```

## prj.conf
```kconfig
#CONFIG_NO_OPTIMIZATIONS=y

CONFIG_SHELL_STACK_SIZE=8192

CONFIG_ZENOH_PICO=y
#CONFIG_NATIVE_UART_0_ON_STDINOUT=y
#CONFIG_NATIVE_UART_AUTOATTACH_DEFAULT_CMD="xterm -fa Monospcae -fs 12 -fg grey -bg black -T cerebri-shell -e screen %s &"

# Kernel options
CONFIG_MAIN_STACK_SIZE=8192
CONFIG_HEAP_MEM_POOL_SIZE=8192
CONFIG_ENTROPY_GENERATOR=y
CONFIG_TEST_RANDOM_GENERATOR=y
CONFIG_INIT_STACKS=y

# Generic library options
CONFIG_NEWLIB_LIBC=y
CONFIG_NEWLIB_LIBC_NANO=n
CONFIG_POSIX_API=y

# Generic networking options
CONFIG_NETWORKING=y

CONFIG_NET_L2_ETHERNET=y
CONFIG_ETH_NATIVE_POSIX=n
CONFIG_ETH_NATIVE_POSIX_RANDOM_MAC=y

CONFIG_NET_IPV4=y
#CONFIG_NET_IPV6=y
CONFIG_NET_TCP=y
CONFIG_NET_ARP=y
CONFIG_NET_UDP=y
CONFIG_NET_DHCPV4=n
CONFIG_NET_SHELL=y
CONFIG_NET_MGMT=y
CONFIG_NET_MGMT_EVENT=y
CONFIG_DNS_RESOLVER=y

# Sockets
CONFIG_NET_SOCKETS=y
CONFIG_NET_SOCKETS_POSIX_NAMES=y
CONFIG_NET_SOCKETS_POLL_MAX=4

# Network driver config
CONFIG_TEST_RANDOM_GENERATOR=y

# Network buffers
CONFIG_NET_PKT_RX_COUNT=16
CONFIG_NET_PKT_TX_COUNT=16
CONFIG_NET_BUF_RX_COUNT=80
CONFIG_NET_BUF_TX_COUNT=80
CONFIG_NET_CONTEXT_NET_PKT_POOL=y

# Network address config
CONFIG_NET_CONFIG_SETTINGS=y
CONFIG_NET_CONFIG_NEED_IPV4=y
CONFIG_NET_IPV4_IGMP=y
#CONFIG_NET_CONFIG_NEED_IPV6=y
#CONFIG_NET_IPV6_MLD=y
CONFIG_NET_CONFIG_MY_IPV4_ADDR="192.0.2.1"
CONFIG_NET_CONFIG_MY_IPV4_NETMASK="255.255.255.0"
CONFIG_NET_CONFIG_MY_IPV4_GW="192.0.2.2"
#CONFIG_NET_CONFIG_PEER_IPV4_ADDR="192.168.10.10"
#CONFIG_NET_CONFIG_MY_IPV6_ADDR="2001:db8::2"
#CONFIG_NET_CONFIG_PEER_IPV6_ADDR="2001:db8::1"

# IP address options
#CONFIG_NET_IF_UNICAST_IPV6_ADDR_COUNT=3
#CONFIG_NET_IF_MCAST_IPV6_ADDR_COUNT=4
CONFIG_NET_MAX_CONTEXTS=10

# Logging
CONFIG_NET_LOG=n
CONFIG_LOG=y
CONFIG_NET_STATISTICS=y
CONFIG_PRINTK=y
```

## src/z_sub.c
```c
//
// Copyright (c) 2022 ZettaScale Technology
//
// This program and the accompanying materials are made available under the
// terms of the Eclipse Public License 2.0 which is available at
// http://www.eclipse.org/legal/epl-2.0, or the Apache License, Version 2.0
// which is available at https://www.apache.org/licenses/LICENSE-2.0.
//
// SPDX-License-Identifier: EPL-2.0 OR Apache-2.0
//
// Contributors:
//   ZettaScale Zenoh Team, <zenoh@zettascale.tech>

#include <stdio.h>
#include <stdlib.h>
#include <zenoh-pico.h>
#include <zephyr/logging/log.h>
#include <zephyr/shell/shell.h>

extern struct k_work_q g_low_priority_work_q;

#define MODE "peer"
//#define CONNECT "udp/192.0.2.1:7447@iface=eth0"
//#define CONNECT "udp/224.0.0.225:7447#iface=en0"
#define CONNECT "udp/224.0.0.225:7447#iface=eth0"

//#define MODE "client"
//#define CONNECT ""

#define KEYEXPR "demo/example/**"

LOG_MODULE_REGISTER(main, CONFIG_CEREBRI_LOG_LEVEL);

static void data_handler(const z_sample_t *sample, void *arg) {
    z_owned_str_t keystr = z_keyexpr_to_string(sample->keyexpr);
    LOG_WRN(" >> [Subscriber handler] Received ('%s': '%.*s')\n", z_loan(keystr), (int)sample->payload.len,
           sample->payload.start);
    z_drop(z_move(keystr));
}

void zenoh_work_handler(struct k_work* work) {
    // Initialize Zenoh Session and other parameters
    z_owned_config_t config = z_config_default();
    zp_config_insert(z_loan(config), Z_CONFIG_MODE_KEY, z_string_make(MODE));
    if (strcmp(CONNECT, "") != 0) {
        zp_config_insert(z_loan(config), Z_CONFIG_CONNECT_KEY, z_string_make(CONNECT));
    }

    // Open Zenoh session
    LOG_WRN("Opening Zenoh Session...");
    z_owned_session_t s = z_open(z_move(config));
    if (!z_check(s)) {
        LOG_WRN("Unable to open session!\n");
	return;
    }
    LOG_WRN("OK\n");

    // Start the receive and the session lease loop for zenoh-pico
    zp_start_read_task(z_loan(s), NULL);
    zp_start_lease_task(z_loan(s), NULL);

    LOG_WRN("Declaring Subscriber on '%s'...", KEYEXPR);
    z_owned_closure_sample_t callback = z_closure(data_handler);
    z_owned_subscriber_t sub = z_declare_subscriber(z_loan(s), z_keyexpr(KEYEXPR), z_move(callback), NULL);
    if (!z_check(sub)) {
        LOG_WRN("Unable to declare subscriber.\n");
	return;
    }
    LOG_WRN("OK!\n");

    while (1) {
        k_msleep(5000);
    }

    LOG_WRN("Closing Zenoh Session...");
    z_undeclare_subscriber(z_move(sub));

    // Stop the receive and the session lease loop for zenoh-pico
    zp_stop_read_task(z_loan(s));
    zp_stop_lease_task(z_loan(s));

    z_close(z_move(s));
    LOG_WRN("OK!\n");

    return;
}

K_WORK_DEFINE(zenoh_work, zenoh_work_handler);

int zenoh_cmd() {
    k_work_submit_to_queue(&g_low_priority_work_q, &zenoh_work);
    return 0;
}

SHELL_CMD_REGISTER(zenoh, NULL, "connect zenoh", zenoh_cmd);
```
